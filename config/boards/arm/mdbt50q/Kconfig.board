## config/boards/arm/mdbt50q/Kconfig.board
```kconfig
# Copyright (c) 2022 The ZMK Contributors
# SPDX-License-Identifier: MIT

config BOARD_MDBT50Q
	bool "mdbt50q"
	depends on SOC_NRF52840_QIAA
```

## config/boards/arm/mdbt50q/Kconfig.defconfig
```kconfig
# Copyright (c) 2022 The ZMK Contributors
# SPDX-License-Identifier: MIT
 
if BOARD_MDBT50Q

config BOARD
	default "mdbt50q"

if USB_DEVICE_STACK

config USB_NRFX
	default y

endif # USB_DEVICE_STACK


config BT_CTLR
	default BT

config ZMK_BLE
	default y

config ZMK_USB
	default y

endif
```

## config/boards/shields/crepe/Kconfig.defconfig
```kconfig
# Copyright (c) 2022 The ZMK Contributors
# SPDX-License-Identifier: MIT

if SHIELD_CREPE

config ZMK_KEYBOARD_NAME
    default "CREPE"
endif
```

## config/boards/shields/skytoucher/Kconfig.defconfig
```kconfig
# Copyright (c) 2022 The ZMK Contributors
# SPDX-License-Identifier: MIT

if SHIELD_SKYTOUCHER_LEFT

config ZMK_KEYBOARD_NAME
    default "Skytoucher"

config ZMK_SPLIT_ROLE_CENTRAL
    default y

endif

if SHIELD_SKYTOUCHER_LEFT || SHIELD_SKYTOUCHER_RIGHT
config ZMK_SPLIT
    default y
endif
```

## config/boards/shields/skytoucher/Kconfig.shield
```kconfig
# Copyright (c) 2022 The ZMK Contributors
# SPDX-License-Identifier: MIT

config SHIELD_SKYTOUCHER_LEFT
    def_bool $(shields_list_contains,skytoucher_left)
    select SPI

config SHIELD_SKYTOUCHER_RIGHT
    def_bool $(shields_list_contains,skytoucher_right)
    select SPI
```
