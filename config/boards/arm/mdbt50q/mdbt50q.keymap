/*
 * Copyright (c) 2022 The ZMK Contributors
 *
 * SPDX-License-Identifier: MIT
 */

#include <behaviors.dtsi>
#include <dt-bindings/zmk/keys.h>


#define BASE
&sl {
  release-after-ms = <60000>;
};

/ {

    keymap {
  		compatible = "zmk,keymap";

		  base_layer {
			  bindings = < &bootloader >;
      };
    };
  };

